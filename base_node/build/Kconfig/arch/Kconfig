## base_node/build/Kconfig/arch/Kconfig
```kconfig
# Load Zephyr Arch Kconfig descriptions.
osource "/Users/majanyberg/zephyrproject/zephyr/arch/rx/Kconfig"
osource "/Users/majanyberg/zephyrproject/zephyr/arch/x86/Kconfig"
osource "/Users/majanyberg/zephyrproject/zephyr/arch/xtensa/Kconfig"
osource "/Users/majanyberg/zephyrproject/zephyr/arch/sparc/Kconfig"
osource "/Users/majanyberg/zephyrproject/zephyr/arch/riscv/Kconfig"
osource "/Users/majanyberg/zephyrproject/zephyr/arch/posix/Kconfig"
osource "/Users/majanyberg/zephyrproject/zephyr/arch/mips/Kconfig"
osource "/Users/majanyberg/zephyrproject/zephyr/arch/arm64/Kconfig"
osource "/Users/majanyberg/zephyrproject/zephyr/arch/arm/Kconfig"
osource "/Users/majanyberg/zephyrproject/zephyr/arch/arc/Kconfig"
```

## base_node/build/Kconfig/boards/Kconfig
```kconfig
# Load Zephyr board Kconfig descriptions.
osource "/Users/majanyberg/zephyrproject/zephyr/boards/raspberrypi/rpi_pico2/Kconfig"
```

## base_node/build/Kconfig/boards/Kconfig.defconfig
```kconfig
# Load Zephyr board defconfig descriptions.
osource "/Users/majanyberg/zephyrproject/zephyr/boards/raspberrypi/rpi_pico2/Kconfig.defconfig"
```

## base_node/build/Kconfig/boards/Kconfig.sysbuild
```kconfig
# Load Sysbuild board Kconfig descriptions.
osource "/Users/majanyberg/zephyrproject/zephyr/boards/raspberrypi/rpi_pico2/Kconfig.sysbuild"
```

## base_node/drivers/sensor_node/Kconfig
```kconfig
#Copyright(c) 2025 Group 8
#SPDX - License - Identifier : Apache - 2.0

config SENSOR_NODE
    bool "Sensor Node Driver"
    default y
    help
      UART driver for home security sensor node.
```

## build_base/Kconfig/arch/Kconfig
```kconfig
# Load Zephyr Arch Kconfig descriptions.
osource "C:/Users/20958/zephyrproject/zephyr/arch/rx/Kconfig"
osource "C:/Users/20958/zephyrproject/zephyr/arch/x86/Kconfig"
osource "C:/Users/20958/zephyrproject/zephyr/arch/xtensa/Kconfig"
osource "C:/Users/20958/zephyrproject/zephyr/arch/sparc/Kconfig"
osource "C:/Users/20958/zephyrproject/zephyr/arch/riscv/Kconfig"
osource "C:/Users/20958/zephyrproject/zephyr/arch/posix/Kconfig"
osource "C:/Users/20958/zephyrproject/zephyr/arch/openrisc/Kconfig"
osource "C:/Users/20958/zephyrproject/zephyr/arch/mips/Kconfig"
osource "C:/Users/20958/zephyrproject/zephyr/arch/arm64/Kconfig"
osource "C:/Users/20958/zephyrproject/zephyr/arch/arm/Kconfig"
osource "C:/Users/20958/zephyrproject/zephyr/arch/arc/Kconfig"
```

## build_base/Kconfig/boards/Kconfig
```kconfig
# Load Zephyr board Kconfig descriptions.
osource "C:/Users/20958/zephyrproject/zephyr/boards/raspberrypi/rpi_pico2/Kconfig"
```

## build_base/Kconfig/boards/Kconfig.defconfig
```kconfig
# Load Zephyr board defconfig descriptions.
osource "C:/Users/20958/zephyrproject/zephyr/boards/raspberrypi/rpi_pico2/Kconfig.defconfig"
```

## build_base/Kconfig/boards/Kconfig.rpi_pico2
```kconfig
# Load board Kconfig descriptions.
osource "C:/Users/20958/zephyrproject/zephyr/boards/raspberrypi/rpi_pico2/Kconfig.rpi_pico2"
```

## build_tests/Kconfig/boards/Kconfig
```kconfig
# Load Zephyr board Kconfig descriptions.
osource "C:/Users/20958/zephyrproject/zephyr/boards/native/native_sim/Kconfig"
```

## build_tests/Kconfig/boards/Kconfig.defconfig
```kconfig
# Load Zephyr board defconfig descriptions.
osource "C:/Users/20958/zephyrproject/zephyr/boards/native/native_sim/Kconfig.defconfig"
```

## build_tests/Kconfig/boards/Kconfig.native_sim
```kconfig
# Load board Kconfig descriptions.
osource "C:/Users/20958/zephyrproject/zephyr/boards/native/native_sim/Kconfig.native_sim"
```

## build_tests/Kconfig/boards/Kconfig.sysbuild
```kconfig
# Load Sysbuild board Kconfig descriptions.
osource "C:/Users/20958/zephyrproject/zephyr/boards/native/native_sim/Kconfig.sysbuild"
```
